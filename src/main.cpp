#include <SPI.h>
#include <Wire.h>
#include <Adafruit_SSD1306.h>
#include <Adafruit_GFX.h>
#include <vector>

#define SCREEN_WIDTH 128
#define SCREEN_HEIGHT 64
#define OLED_CLK  36
#define OLED_MOSI 35
#define OLED_RES  34
#define OLED_DC   33
#define OLED_CS   32

Adafruit_SSD1306 display(SCREEN_WIDTH, SCREEN_HEIGHT, OLED_MOSI, OLED_CLK, OLED_DC, OLED_RES, OLED_CS);

// 'EZ_Pedal_Logo', 128x64px
const unsigned char epd_bitmap_EZ_Pedal_Logo [] PROGMEM = {
	0x00, 0x00, 0x00, 0x00, 0x00, 0x00, 0x00, 0x00, 0x00, 0x00, 0x00, 0x00, 0x00, 0x00, 0x00, 0x00, 
	0x00, 0x00, 0x00, 0x00, 0x00, 0x00, 0x00, 0x00, 0x00, 0x00, 0x00, 0x00, 0x00, 0x00, 0x00, 0x00, 
	0x00, 0x00, 0x00, 0x00, 0x00, 0x00, 0x00, 0x00, 0x00, 0x00, 0x00, 0x00, 0x00, 0x00, 0x00, 0x00, 
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	0x00, 0x00, 0x00, 0x00, 0x00, 0x00, 0x00, 0x00, 0x00, 0x00, 0x00, 0x00, 0x00, 0x00, 0x00, 0x00
};

// Array of all bitmaps for convenience. (Total bytes used to store images in PROGMEM = 1040)
const int epd_bitmap_allArray_LEN = 1;
const unsigned char* epd_bitmap_allArray[1] = {
	epd_bitmap_EZ_Pedal_Logo
};





void Out_Bitmap_X(int x, int y, int LeftRight, int dist, int dly, int spd, const unsigned char* bmp) {
	// x: start position; y: start position; LeftRight: -1 for left, 1 for right; dist: distance to move; dly: delay between frames, dly must bigger than spd; spd: speed of movement
	int x_p = x;
	int y_p = y;
	int spd_t = spd;
	for (int i = 0; i < dist; i++) {
		for (int j = 0; j < spd_t;j++) {
			x_p = x_p + LeftRight;
			display.clearDisplay();
			display.drawBitmap(x_p, y_p, bmp, 128, 64, SSD1306_WHITE);
			display.display();
			delay(dly - spd_t);
		}
		if (spd_t < dly) {
			spd_t = spd_t + spd; 
		}
		
	}
}



// void Move_Bitmap(int x, int y, int x_t, int y_t, int dly, const unsigned char* bmp) {
// 	// x: start position; y: start position; LeftRight: -1 for left, 1 for right; dist: distance to move; dly: delay between frames, dly must bigger than spd; spd: speed of movement
// 	int x_p = x;
// 	int y_p = y;
// 	int dist_x = x_t - x;
// 	int spd_x = 1;
// 	int dist_y = y_t - y;
// 	int spd_y = 1;
// 	int delay_x = 0;
// 	int delay_y = 0;
// 	for (; x_p < dist_x / 2) {
// 		if (delay_x = 0) {
// 			display.clearDisplay();		
// 		}
// 	}
// }



int Move_Bitmap(int x, int y, int x_t, int y_t, int dly, const unsigned char* bmp, String return_xy) { //参数外置
	// x: start position; y: start position; LeftRight: -1 for left, 1 for right; dist: distance to move; dly: delay between frames, dly must bigger than spd; spd: speed of movement
	int x_p = x;
	int y_p = y;
	int dist_x = abs(x_t - x);
	int spd_x = 1;
	int dist_y = abs(y_t - y);
	int spd_y = 1;
	int delay_x = 0;
	int delay_y = 0;

	while (abs(x_p - x_t) < dist_x / 2) {
		
		if (delay_x < 1) {
			//判断方向并更新位置
			if (x - x_t < 0) {
				x_p = x_p + 1;
			}
			else {
				x_p = x_p - 1;
			}
		}
		if (delay_y < 1) {
			//判断方向并更新位置
			if (y - y_t < 0) {
				y_p = y_p + 1;
			}
			else {
				y_p = y_p - 1;
			}
		}
		delay_x -= 1;
		delay_y -= 1;
		spd_x += 1;
		spd_y += 1;
	}
	while (abs(x_p - x_t) >= dist_x / 2) {
		spd_x -= 1;
		spd_y -= 1;
	}

	
	if (return_xy == "x") {
		return x_p;
	}
	else {
		return y_p;
	}
}


/////////////////////////////////////////////////////////////////////////////////////////////////



void setup() {
    Serial.println("Device Online");

  if(!display.begin(SSD1306_SWITCHCAPVCC)) {
    Serial.println("SSD1306 Setup Failed!");
    while(1); // 停止执行
  }
  
  //Setup Done!

  delay(100);
  Serial.println("Check");
  
  //Display Test
	int logo_pos = 0;
	for (int i=0; i<128; i++) { 
		display.clearDisplay();
		logo_pos = (pow(i-128,2)+pow(i-128,2))/256;
		display.drawBitmap(logo_pos, 0, epd_bitmap_EZ_Pedal_Logo, 128, 64, SSD1306_WHITE);
		display.display();
		delay(10);
	}




  // display.clearDisplay();
  // display.drawBitmap(0, 0, epd_bitmap_EZ_Pedal_Logo, 128, 64, SSD1306_WHITE);
  // display.display();

  Serial.println("Setup Finished!");


  // Display "By ARPO"
  const char* text = "By ARPO";
  int x = 58;
  int y = 20;
  display.setTextColor(SSD1306_WHITE);
  display.setTextSize(1);

  for (int i = 0; text[i] != '\0'; i++) {
    display.setCursor(x, y);
    display.print(text[i]);
    display.display();
    x += 6;
    delay(100);
  }

	Out_Bitmap_X(0, 0, -1, 130, 15, 1, epd_bitmap_EZ_Pedal_Logo);
//   for (int i = 0; i < 2048; i++) {
// 	display.drawPixel(random(0, 127), random(0, 63), SSD1306_WHITE);
// 	display.display();
// 	delay(10);
//   }





}

void loop() {
	
}
