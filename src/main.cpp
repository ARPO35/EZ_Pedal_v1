#include <SPI.h>
#include <Wire.h>
#include <Adafruit_SSD1306.h>
#include <Adafruit_GFX.h>
#include <usb_midi.h>
#include <vector>
#include <cmath>

usb_midi_class usbMidi;

#define SCREEN_WIDTH 128
#define SCREEN_HEIGHT 64
#define OLED_CLK 36
#define OLED_MOSI 35
#define OLED_RES 34
#define OLED_DC 33
#define OLED_CS 32

int channel = 1;
int analog1_maped;
int analog1_output;
int deb;
int level = 0;
int deadzone_s = 0;
int deadzone_e = 127;
int select_item;
int smooth_in;
int temp1 = 0;
int temp2 = 0;
int temp3 = 0;
const int pages_index = 3;
String pages[pages_index] = {"main", "deadzon", "dev"};
int  bLeft = 0;
int  bRight = 0;
int  bEnter = 0;
int  bExit = 0;
bool cLeft = false;
bool cRight = false;
bool cEnter = false;
bool cExit = false;

const int SMOOTH_SIZE = 1024;
int smoothValues[SMOOTH_SIZE];

struct ValueLine
{
	int x;
	int y;
	int value = 0;
};
ValueLine valueline;

struct PageSwitch
{
	String page = pages[1];
	int step = 0;
};
PageSwitch page;

struct PageTitle
{
	String title = page.page;
	int x = 0;
	int y = 0;
};
PageTitle page_now;



Adafruit_SSD1306 display(SCREEN_WIDTH, SCREEN_HEIGHT, OLED_MOSI, OLED_CLK, OLED_DC, OLED_RES, OLED_CS);

void deadzone_v() {
	//ValueLine
	const String string_raw = "RAW";
	const String string_help = "Exit[   ]  Enter[   ]";
	const String string_min = "min";
	const String string_max = "max";
	valueline.y = map(smooth_in, 0, 127, 128, 32);
	display.drawLine(map(analog1_maped, 0, 127, 30, 127), valueline.y, map(analog1_maped, 0, 127, 30, 127), valueline.y - 5, SSD1306_WHITE); 	//RAW h_line
	display.drawLine(map(deadzone_s, 0, 127, 30, 127), 	  valueline.y, map(deadzone_s,    0, 127, 30, 127), valueline.y - 5, SSD1306_WHITE); 	//deadzone start
	display.drawLine(map(deadzone_e, 0, 127, 30, 127),    valueline.y, map(deadzone_e,    0, 127, 30, 127), valueline.y - 5, SSD1306_WHITE); 	//deadzone end
	display.drawLine(30,  valueline.y - 6, 127, valueline.y - 6, SSD1306_WHITE);
	display.drawLine(30,  valueline.y, 	   127, valueline.y, 	 SSD1306_WHITE);
	display.drawLine(30,  valueline.y, 	   30,  valueline.y - 6, SSD1306_WHITE);
	display.drawLine(127, valueline.y, 	   127, valueline.y - 6, SSD1306_WHITE);
	for (unsigned int i = 0; i < string_raw.length(); i++) {
		display.drawChar(0 + (i * 6), valueline.y - 6, string_raw[i], SSD1306_WHITE, SSD1306_BLACK, 1);
	}

	//show help
	for (unsigned int i = 0; i < string_help.length(); i++) {
		display.drawChar(i*6, 56, string_help[i], SSD1306_WHITE, SSD1306_BLACK, 1);
	}
	if (temp1 <= 0) {
		for (unsigned int i = 0; i < string_min.length(); i++) {
			display.drawChar(i*6+30, 56, string_min[i], SSD1306_WHITE, SSD1306_BLACK, 1);
		}
	}
	else {
		for (unsigned int i = 0; i < string_min.length(); i++) {
			display.drawChar(i*6+30, 56, string_min[i], SSD1306_BLACK, SSD1306_WHITE, 1);
		}
	}
	if (temp2 <= 0) {
		for (unsigned int i = 0; i < string_max.length(); i++) {
			display.drawChar(i*6+102, 56, string_max[i], SSD1306_WHITE, SSD1306_BLACK, 1);
		}
	}
	else {
		for (unsigned int i = 0; i < string_max.length(); i++) {
			display.drawChar(i*6+102, 56, string_max[i], SSD1306_BLACK, SSD1306_WHITE, 1);
		}
	}

	if (cExit) {
		cExit = false;
		deadzone_s = analog1_maped;
		temp1 = 50;
	}
	if (cEnter) {
		cEnter = false;
		deadzone_e = analog1_maped;
		temp2 = 50;
	}
	if (temp1 >= 0) {temp1 -= 1;}
	if (temp2 >= 0) {temp2 -= 1;}
	
}

float easingCurve(int i, int size) {      
	float out;
	// 先归一化i到0-1范围
	float t = static_cast<float>(i) / (SMOOTH_SIZE - 1);
	// 计算三次缓入缓出
	float value = (t < 0.5f) ? 4 * t * t * t : 1 - 4 * (1 - t) * (1 - t) * (1 - t);
	// 映射到0-SMOOTH_SIZE范围
	out = map(value, 0, 1, 0, SMOOTH_SIZE - 1);
	return out;
}

void dev_showcurve() {
	if (page.step <= 127) {
		int x, y, s;
		s = map(page.step, 0, 127, 0, SMOOTH_SIZE);
		for (int i = 0; i < s; i++) {
			x = map(i, 0, SMOOTH_SIZE, 0, 127);
			y = map(smoothValues[i], 0, SMOOTH_SIZE, 63, 0);
			display.drawPixel(x, y, SSD1306_WHITE);
		}
	}
}

// void dev_showcurve() {
// 	if (page.step <= 127) {
// 		int x, y, s;
// 		s = map(page.step, 0, 127, 0, SMOOTH_SIZE);
// 		for (int i = 0; i < s; i++) {
// 			x = (int)map(easingCurve(i, 127), 0, 1, 0, 127);
// 			y = (int)map(easingCurve(i, 127), 0, 1, 63, 0);
// 			display.drawPixel(x, y, SSD1306_WHITE);
// 			Serial.print("e: ");
// 			Serial.println(easingCurve(i, 127));
// 		}
// 	}
// }

void Setup_SmoothCurveData() {
    for(int i = 0; i < SMOOTH_SIZE; i++) {
        // 先归一化i到0-1范围
        float t = static_cast<float>(i) / (SMOOTH_SIZE - 1);
        // 计算三次缓入缓出
        float value = (t < 0.5f) ? 4 * t * t * t : 1 - 4 * (1 - t) * (1 - t) * (1 - t);
        // 映射到0-SMOOTH_SIZE范围
        smoothValues[i] = map(value, 0, 1, 0, SMOOTH_SIZE - 1);
    }
}


void switchPage(int dir) { //dir only +1/-1
	int current_page_index = 0;
	int target_page_index;
	
	for (; current_page_index < pages_index; current_page_index++) {
		if (page.page == pages[current_page_index]) {
			break;
		}
	}
	
	target_page_index = current_page_index + dir;
	if (target_page_index < 0) {
		target_page_index = pages_index - 1;
	}
	else if (target_page_index >= pages_index) {
		target_page_index = 0;
	}
	
	page.page = pages[target_page_index];
	page.step = 0;
	page_now.title = page.page;
	page_now.x = 0;
	page_now.y = 0;
	temp1 = 0;
	temp2 = 0;
	temp3 = 0;
}

// void ShowPageTitle() {
// 		//Page Now
// 		page_now.y = map(page.step, 0, 127, 0, 8);
// 		for (unsigned int i = 0; i < page_now.title.length(); i++) {
// 			display.drawChar(page_now.x + (i*6), page_now.y, page_now.title[i], SSD1306_WHITE, SSD1306_BLACK, 1);
// 		}
// 		display.drawLine(page_now.x+1 + (page_now.title.length() * 6), page_now.y, page_now.x+1 + (page_now.title.length() * 6), page_now.y + 8, SSD1306_WHITE);
// 		display.drawLine(page_now.x, page_now.y + 9, page_now.x+1 + (page_now.title.length() * 6), page_now.y + 9, SSD1306_WHITE);
// }

void ShowPageTitle() { //for X
		page_now.x = map(smooth_in, 0, 127, -page_now.title.length() * 12, 0);
		page_now.y = 8;
		for (unsigned int i = 0; i < page_now.title.length(); i++) {
			display.drawChar(page_now.x + (i*6), page_now.y, page_now.title[i], SSD1306_WHITE, SSD1306_BLACK, 1);
		}
		display.drawLine(page_now.x+1 + (page_now.title.length() * 6), page_now.y, page_now.x+1 + (page_now.title.length() * 6), page_now.y + 8, SSD1306_WHITE);
		display.drawLine(page_now.x, page_now.y + 9, page_now.x+1 + (page_now.title.length() * 6), page_now.y + 9, SSD1306_WHITE);
}


void smooth_Circle_Test() {
	int x = map(smoothValues[temp1], 0, SMOOTH_SIZE, 0, 127);
	int y = 32;
	display.drawCircle(x, y, 16, SSD1306_WHITE);
}

// 'EZ_Pedal_Logo', 128x64px
const unsigned char epd_bitmap_EZ_Pedal_Logo[] PROGMEM = {
	0x00, 0x00, 0x00, 0x00, 0x00, 0x00, 0x00, 0x00, 0x00, 0x00, 0x00, 0x00, 0x00, 0x00, 0x00, 0x00,
	0x00, 0x00, 0x00, 0x00, 0x00, 0x00, 0x00, 0x00, 0x00, 0x00, 0x00, 0x00, 0x00, 0x00, 0x00, 0x00,
	0x00, 0x00, 0x00, 0x00, 0x00, 0x00, 0x00, 0x00, 0x00, 0x00, 0x00, 0x00, 0x00, 0x00, 0x00, 0x00,
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	0x00, 0x00, 0x00, 0x00, 0x00, 0x00, 0x00, 0x00, 0x00, 0x00, 0x00, 0x00, 0x00, 0x00, 0x00, 0x00};
// Array of all bitmaps for convenience. (Total bytes used to store images in PROGMEM = 1040)
const int epd_bitmap_allArray_LEN = 1;
const unsigned char *epd_bitmap_allArray[1] = {
	epd_bitmap_EZ_Pedal_Logo};


void Out_Bitmap_X(int x, int y, int LeftRight, int dist, int dly, int spd, const unsigned char *bmp)
{
	// x: start position; y: start position; LeftRight: -1 for left, 1 for right; dist: distance to move; dly: delay between frames, dly must bigger than spd; spd: speed of movement
	int x_p = x;
	int y_p = y;
	int spd_t = spd;
	for (int i = 0; i < dist; i++)
	{
		for (int j = 0; j < spd_t; j++)
		{
			x_p = x_p + LeftRight;
			display.clearDisplay();
			display.drawBitmap(x_p, y_p, bmp, 128, 64, SSD1306_WHITE);
			display.display();
			delay(dly - spd_t);
		}
		if (spd_t < dly)
		{
			spd_t = spd_t + spd;
		}
	}
}

// Display "By ARPO"
void char_arpo() {
	const char *text = "By ARPO";
	int x = 58;
	int y = 20;
	display.setTextColor(SSD1306_WHITE);
	display.setTextSize(1);

	for (int i = 0; text[i] != '\0'; i++)
	{
		display.setCursor(x, y);
		display.print(text[i]);
		display.display();
		x += 6;
		delay(100);
	}
	delay(500);
	x = 58;
	y = 20;
	display.setTextColor(SSD1306_WHITE);
	display.setTextSize(1);

	for (int i = 0; i < 50; i++)
	{
		display.drawLine(x, y, x, y + 8, SSD1306_BLACK);
		x += 1;
		display.display();
		delay(10);
	}
	delay(100);
}

// void Move_Bitmap(int x, int y, int x_t, int y_t, int dly, const unsigned char* bmp) {
// 	// x: start position; y: start position; LeftRight: -1 for left, 1 for right; dist: distance to move; dly: delay between frames, dly must bigger than spd; spd: speed of movement
// 	int x_p = x;
// 	int y_p = y;
// 	int dist_x = x_t - x;
// 	int spd_x = 1;
// 	int dist_y = y_t - y;
// 	int spd_y = 1;
// 	int delay_x = 0;
// 	int delay_y = 0;
// 	for (; x_p < dist_x / 2) {
// 		if (delay_x = 0) {
// 			display.clearDisplay();
// 		}
// 	}
// }

// int Move_Bitmap(int x, int y, int x_t, int y_t, int dly, const unsigned char *bmp, String return_xy)
// { // 参数外置
// 	// x: start position; y: start position; LeftRight: -1 for left, 1 for right; dist: distance to move; dly: delay between frames, dly must bigger than spd; spd: speed of movement
// 	int x_p = x;
// 	int y_p = y;
// 	int dist_x = abs(x_t - x);
// 	int spd_x = 1;
// 	int dist_y = abs(y_t - y);
// 	int spd_y = 1;
// 	int delay_x = 0;
// 	int delay_y = 0;
// 	while (abs(x_p - x_t) < dist_x / 2)
// 	{
// 		if (delay_x < 1)
// 		{
// 			// 判断方向并更新位置
// 			if (x - x_t < 0)
// 			{
// 				x_p = x_p + 1;
// 			}
// 			else
// 			{
// 				x_p = x_p - 1;
// 			}
// 		}
// 		if (delay_y < 1)
// 		{
// 			// 判断方向并更新位置
// 			if (y - y_t < 0)
// 			{
// 				y_p = y_p + 1;
// 			}
// 			else
// 			{
// 				y_p = y_p - 1;
// 			}
// 		}
// 		delay_x -= 1;
// 		delay_y -= 1;
// 		spd_x += 1;
// 		spd_y += 1;
// 	}
// 	while (abs(x_p - x_t) >= dist_x / 2)
// 	{
// 		spd_x -= 1;
// 		spd_y -= 1;
// 	}
// 	if (return_xy == "x")
// 	{
// 		return x_p;
// 	}
// 	else
// 	{
// 		return y_p;
// 	}
// }

/////////////////////////////////////////////////////////////////////////////////////////////////

void setup()
{
	pinMode(15, INPUT);
	pinMode(4, INPUT);
	pinMode(5, INPUT);
	pinMode(6, INPUT);
	pinMode(7, INPUT);
	deb = analogRead(15);
	page.page = "main";
	Setup_SmoothCurveData();

	Serial.println("Device Online");

	if (!display.begin(SSD1306_SWITCHCAPVCC))
	{
		Serial.println("SSD1306 Setup Failed!");
		while (1)
			; // 停止执行
	}

	// Setup Done!

	delay(100);
	Serial.println("Check");

	// Display Test
	int logo_pos = 0;
	for (int i = 0; i < 128; i++)
	{
		display.clearDisplay();
		// logo_pos = (pow(i-128,2)+pow(i-128,2))/256;
		logo_pos = pow(i - 128, 2) / 128;
		display.drawBitmap(logo_pos, 0, epd_bitmap_EZ_Pedal_Logo, 128, 64, SSD1306_WHITE);
		display.display();
		delay(10);
	}

	// display.clearDisplay();
	// display.drawBitmap(0, 0, epd_bitmap_EZ_Pedal_Logo, 128, 64, SSD1306_WHITE);
	// display.display();

	Serial.println("Setup Finished!");


	char_arpo();
	

	Out_Bitmap_X(0, 0, -1, 130, 15, 1, epd_bitmap_EZ_Pedal_Logo);
	//   for (int i = 0; i < 2048; i++) {
	// 	display.drawPixel(random(0, 127), random(0, 63), SSD1306_WHITE);
	// 	display.display();
	// 	delay(10);
	//   }
}

void loop() {
	display.clearDisplay();

	//CC1 Output
	int currentValue = analogRead(15);
	if (abs(deb - currentValue) > 7) {
		deb = currentValue;
		analog1_maped = map(deb, 0, 1023, 0, 127);
		if (analog1_maped < deadzone_s) {
			analog1_output = 0;	
		}
		else if (analog1_maped > deadzone_e) {
			analog1_output = 127;
		}
		else {
			analog1_output = map(analog1_maped, deadzone_s, deadzone_e, 0, 127);
		}
		Serial.print("MidiCC");
		Serial.print(channel);
		Serial.print(": ");
		Serial.print(currentValue);
		Serial.print("	");
		Serial.print(deb);
		Serial.print("	");
		Serial.println(analog1_output);
		usbMidi.sendControlChange(1, analog1_output, channel);
	}

	//Controll
	if (digitalRead(4) == HIGH) {
		bLeft = 100;
	}
	if (bLeft > 0) {
		bLeft -= 1;
		if (digitalRead(4) == LOW) {
			bLeft = 0;
			cLeft = true;
		}
	}
	if (digitalRead(5) == HIGH) {
		bRight = 100;
	}
	if (bRight > 0) {
		bRight -= 1;
		if (digitalRead(5) == LOW) {
			bRight = 0;
			cRight = true;
		}
	}
	if (digitalRead(6) == HIGH) {
		bExit = 100;
	}
	if (bExit > 0) {
		bExit -= 1;
		if (digitalRead(6)) {
			bExit = 0;
			cExit = true;
		}
	}
	if (digitalRead(7) == HIGH) {
		bEnter = 100;
	}
	if (bEnter > 0) {
		bEnter -= 1;
		if (digitalRead(7)) {
			bEnter = 0;
			cEnter = true;
		}
	}

	//Button response
	//main deadzone dev
	if (cLeft) {
		cLeft = false;
		if (level == 0) {
			switchPage(-1);
		}
		else if (level == 1) {
			select_item -= 1;
		}
	}
	if (cRight) {
		cRight = false;
		if (level == 0) {
			switchPage(1);
		}
		else if (level == 1) {
			select_item -= 1;
		}
	}

	//display
	if (page.page == "main") {
		if (page.step < 127) {
			page.step += 1;
			smooth_in = map(smoothValues[map(page.step, 0, 127, 0, SMOOTH_SIZE - 1)], 0, SMOOTH_SIZE - 1, 0, 127);
		}
		//ValueLine
		valueline.y = map(smooth_in, 0, 127, 70, 63);
		for (int i = 0; i < 5; i++) {
			display.drawLine(0, valueline.y - i, analog1_output, valueline.y - i, SSD1306_WHITE);
		}
		display.drawLine(0,   valueline.y - 5, 127, valueline.y - 5, SSD1306_WHITE);
		display.drawLine(0,   valueline.y, 	   127, valueline.y, 	 SSD1306_WHITE);
		display.drawLine(0,   valueline.y, 	   0,   valueline.y - 5, SSD1306_WHITE);
		display.drawLine(127, valueline.y, 	   127, valueline.y - 5, SSD1306_WHITE);
		ShowPageTitle();
	}
	else if (page.page == "deadzon") {
		if (page.step < 127) {
			page.step += 1;
			temp1 = 0;
			temp2 = 0;
			temp3 = 0;
			smooth_in = map(smoothValues[map(page.step, 0, 127, 0, SMOOTH_SIZE - 1)], 0, SMOOTH_SIZE - 1, 0, 127);
		}
		ShowPageTitle();
		deadzone_v();
	}
	else if (page.page == "dev") {
		if (page.step < 127) {
			page.step += 1;
			temp1 = 0;
			temp2 = 0;
			temp3 = 0;
			smooth_in = map(smoothValues[map(page.step, 0, 127, 0, SMOOTH_SIZE - 1)], 0, SMOOTH_SIZE - 1, 0, 127);
		}
		if (temp1 < SMOOTH_SIZE) {
			temp1 += 1;
		}
		else {
			temp1 = 0;
		}
		ShowPageTitle();
		smooth_Circle_Test();
		dev_showcurve();
	}
	
	display.display();
	delay(2);
}
